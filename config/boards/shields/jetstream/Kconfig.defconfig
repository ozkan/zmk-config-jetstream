## config/boards/shields/jetstream/Kconfig.defconfig
```kconfig
# Copyright (c) 2021 - 2023 The ZMK Contributors
# SPDX-License-Identifier: MIT

if SHIELD_JETSTREAM

config ZMK_KEYBOARD_NAME
    default "Jetstream"
endif
```

## config/boards/shields/jetstream/Kconfig.shield
```kconfig
# Copyright (c) 2023 The ZMK Contributors
# SPDX-License-Identifier: MIT

config SHIELD_JETSTREAM
    def_bool $(shields_list_contains,jetstream)
```
